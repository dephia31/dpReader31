## boards/metalio_s31/sdkconfig.defaults
```kconfig
# 本板独有的 SDK 配置，追加在根 sdkconfig.defaults 之后，因此这里优先。
# Board-specific SDK configuration, appended after the shared root file, so values here win.

# CONFIG_SPIRAM_TRY_ALLOCATE_WIFI_LWIP is not set
CONFIG_ESP_WIFI_STATIC_RX_BUFFER_NUM=12
CONFIG_ESP_WIFI_DYNAMIC_RX_BUFFER_NUM=32
# CONFIG_ESP_WIFI_STATIC_TX_BUFFER is not set
CONFIG_ESP_WIFI_DYNAMIC_TX_BUFFER=y
CONFIG_ESP_WIFI_DYNAMIC_TX_BUFFER_NUM=32
CONFIG_ESP_WIFI_RX_BA_WIN=12
# S31控制器采用本SDK原生默认值，不保留S3的BLE_MAX_ACT配置。
# Use native S31 controller settings rather than S3 BLE_MAX_ACT.
CONFIG_ESP_COEX_SW_COEXIST_ENABLE=y
CONFIG_IDF_TARGET="esp32s31"
CONFIG_ESPTOOLPY_FLASHMODE_DIO=y
CONFIG_ESPTOOLPY_FLASHFREQ_80M=y
CONFIG_SPIRAM_SPEED_200M=y
CONFIG_SPIRAM_MALLOC_RESERVE_INTERNAL=65536
CONFIG_ESP_DEFAULT_CPU_FREQ_MHZ_300=y
CONFIG_PARTITION_TABLE_CUSTOM_FILENAME="boards/metalio_s31/partitions.csv"
CONFIG_READ_PICO_I2C_FREQ_HZ=100000
CONFIG_READ_PICO_I2C_PORT=1
CONFIG_READ_PICO_I2C_SDA_GPIO=0
CONFIG_READ_PICO_I2C_SCL_GPIO=1
CONFIG_READ_PICO_IOE_INT_GPIO=2
CONFIG_READ_PICO_TP_INT_GPIO=5
CONFIG_TINYUSB_DESC_PRODUCT_STRING="kiikoread Metalio S31"
CONFIG_TINYUSB_DESC_MANUFACTURER_STRING="kiikoread"


# CONFIG_LWIP_SNTP_STARTUP_DELAY is not set

CONFIG_LWIP_TCP_WND_DEFAULT=32768

CONFIG_LWIP_TCP_SND_BUF_DEFAULT=16384

CONFIG_LWIP_TCP_RECVMBOX_SIZE=24

CONFIG_LWIP_TCPIP_RECVMBOX_SIZE=48
```

## main/Kconfig.projbuild
```kconfig
menu "dpReader data protection"
    config DPREADER_AUTO_BACKUP
        bool "Enable automatic SD backup support"
        default y
        depends on IDF_TARGET_ESP32S31 && SPIRAM_ALLOW_BSS_SEG_EXTERNAL_MEMORY
        help
            Builds the Backup/Restore switch, enabled by default until the user
            saves an off preference. Saves only before Sleep and firmware updates.
            No new task is created. Peak internal SRAM requires device measurement.
            Backup data and stream buffers use PSRAM exclusively on S31.
    config DPREADER_AUTO_RESTORE
        bool "Enable device-bound automatic recovery after peak-SRAM validation"
        default n
        depends on DPREADER_AUTO_BACKUP
        help
            Attempt recovery once at boot only after known settings-namespace loss.
            Requires a V26 backup bound to this device. Interrupted/failed attempts
            remain blocked until explicit manual recovery; no erase or reboot loop.
endmenu
```
